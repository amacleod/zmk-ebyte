## boards/arm/ebyte_e73_2g4m08s1c/Kconfig
```kconfig
# SPDX-License-Identifier: MIT

config BOARD_ENABLE_DCDC
       bool "Enable DCDC mode"
       select SOC_DCDC_NRF52X
       default y
       depends on BOARD_EBYTE_E73_2G4M08S1C
```

## boards/arm/ebyte_e73_2g4m08s1c/Kconfig.board
```kconfig
# SPDX-License-Identifier: MIT


config BOARD_EBYTE_E73_2G4M08S1C
       bool "E73-2G4M08S1C"
       depends on SOC_NRF52840_QIAA
```

## boards/arm/ebyte_e73_2g4m08s1c/Kconfig.defconfig
```kconfig
# SPDX-License-Identifier: MIT

if BOARD_EBYTE_E73_2G4M08S1C

config BOARD
    default "ebyte_e73_2g4m08s1c"

if USB_DEVICE_STACK

config USB_NRFX
    default y

endif # USB_DEVICE_STACK

config BT_CTLR
    default BT

endif # BOARD_EBYTE_E73_2G4M08S1C
```

## boards/arm/ebyte_e73_2g4m08s1c/ebyte_e73_2g4m08s1c_defconfig
```kconfig
# SPDX-License-Identifier: MIT

CONFIG_SOC_SERIES_NRF52X=y
CONFIG_SOC_NRF52840_QIAA=y
CONFIG_BOARD_EBYTE_E73_2G4M08S1C=y

CONFIG_ARM_MPU=y

CONFIG_PINCTRL=y

CONFIG_GPIO=y

CONFIG_USE_DT_CODE_PARTITION=y
CONFIG_OUTPUT_UF2=y

CONFIG_MPU_ALLOW_FLASH_WRITE=y
CONFIG_NVS=y
CONFIG_SETTINGS_NVS=y
CONFIG_FLASH=y
CONFIG_FLASH_PAGE_LAYOUT=y
CONFIG_FLASH_MAP=y

CONFIG_ZMK_BLE=y
CONFIG_ZMK_USB=y
```
